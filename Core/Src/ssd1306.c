#include "ssd1306.h"
#include <stdio.h>
#include <stdlib.h>
#include <stdarg.h>

static I2C_HandleTypeDef *ssd1306_i2c;
static uint8_t SSD1306_Buffer[SSD1306_WIDTH * SSD1306_HEIGHT / 8];

// Current X and Y coordinate for text
static uint8_t SSD1306_X;
static uint8_t SSD1306_Y;

// 5x7 Font
static const uint8_t Font5x7[][5] = {
    {0x00, 0x00, 0x00, 0x00, 0x00}, // space
    {0x00, 0x00, 0x5F, 0x00, 0x00}, // !
    {0x00, 0x07, 0x00, 0x07, 0x00}, // "
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    {0x02, 0x01, 0x02, 0x04, 0x02}, // ~
};

// Write command to SSD1306
static void SSD1306_WriteCommand(uint8_t command) {
    HAL_I2C_Mem_Write(ssd1306_i2c, SSD1306_I2C_ADDR, 0x00, 1, &command, 1, 100);
}

// Initialize SSD1306
uint8_t SSD1306_Init(I2C_HandleTypeDef *hi2c) {
    ssd1306_i2c = hi2c;
    
    // Check if device is ready
    if (HAL_I2C_IsDeviceReady(ssd1306_i2c, SSD1306_I2C_ADDR, 3, 100) != HAL_OK) {
        return 0;
    }
    
    HAL_Delay(100);
    
    // Init commands for 128x64 OLED
    SSD1306_WriteCommand(0xAE); // Display off
    SSD1306_WriteCommand(0x20); // Set Memory Addressing Mode
    SSD1306_WriteCommand(0x00); // Horizontal addressing mode
    SSD1306_WriteCommand(0xB0); // Set Page Start Address
    SSD1306_WriteCommand(0xC8); // Set COM Output Scan Direction
    SSD1306_WriteCommand(0x00); // Set low column address
    SSD1306_WriteCommand(0x10); // Set high column address
    SSD1306_WriteCommand(0x40); // Set start line address
    SSD1306_WriteCommand(0x81); // Set contrast control
    SSD1306_WriteCommand(0xFF); // Max brightness
    SSD1306_WriteCommand(0xA1); // Set segment re-map
    SSD1306_WriteCommand(0xA6); // Set normal display
    SSD1306_WriteCommand(0xA8); // Set multiplex ratio
    SSD1306_WriteCommand(0x3F); // 1/64 duty
    SSD1306_WriteCommand(0xA4); // Display follows RAM content
    SSD1306_WriteCommand(0xD3); // Set display offset
    SSD1306_WriteCommand(0x00); // No offset
    SSD1306_WriteCommand(0xD5); // Set display clock divide ratio
    SSD1306_WriteCommand(0xF0); // Suggested value
    SSD1306_WriteCommand(0xD9); // Set pre-charge period
    SSD1306_WriteCommand(0x22); // Suggested value
    SSD1306_WriteCommand(0xDA); // Set com pins hardware configuration
    SSD1306_WriteCommand(0x12);
    SSD1306_WriteCommand(0xDB); // Set vcomh
    SSD1306_WriteCommand(0x20); // 0.77xVcc
    SSD1306_WriteCommand(0x8D); // Set DC-DC enable
    SSD1306_WriteCommand(0x14);
    SSD1306_WriteCommand(0xAF); // Display on
    
    SSD1306_Fill(SSD1306_BLACK);
    SSD1306_UpdateScreen();
    
    SSD1306_X = 0;
    SSD1306_Y = 0;
    
    return 1;
}

// Fill entire screen
void SSD1306_Fill(uint8_t color) {
    memset(SSD1306_Buffer, (color == SSD1306_BLACK) ? 0x00 : 0xFF, sizeof(SSD1306_Buffer));
}

// Update screen from buffer
void SSD1306_UpdateScreen(void) {
    for (uint8_t i = 0; i < 8; i++) {
        SSD1306_WriteCommand(0xB0 + i);
        SSD1306_WriteCommand(0x00);
        SSD1306_WriteCommand(0x10);
        HAL_I2C_Mem_Write(ssd1306_i2c, SSD1306_I2C_ADDR, 0x40, 1, &SSD1306_Buffer[SSD1306_WIDTH * i], SSD1306_WIDTH, 100);
    }
}

// Draw pixel
void SSD1306_DrawPixel(uint8_t x, uint8_t y, uint8_t color) {
    if (x >= SSD1306_WIDTH || y >= SSD1306_HEIGHT) return;
    
    if (color == SSD1306_WHITE) {
        SSD1306_Buffer[x + (y / 8) * SSD1306_WIDTH] |= 1 << (y % 8);
    } else {
        SSD1306_Buffer[x + (y / 8) * SSD1306_WIDTH] &= ~(1 << (y % 8));
    }
}

// Set cursor position
void SSD1306_GotoXY(uint8_t x, uint8_t y) {
    SSD1306_X = x;
    SSD1306_Y = y;
}

// Put char
char SSD1306_Putc(char ch, uint8_t color) {
    if (SSD1306_WIDTH < (SSD1306_X + 6) || SSD1306_HEIGHT < (SSD1306_Y + 8)) {
        return 0;
    }
    
    for (uint8_t i = 0; i < 5; i++) {
        uint8_t line = (ch < 32 || ch > 126) ? 0 : Font5x7[ch - 32][i];
        for (uint8_t j = 0; j < 8; j++) {
            if (line & (1 << j)) {
                SSD1306_DrawPixel(SSD1306_X + i, SSD1306_Y + j, color);
            } else {
                SSD1306_DrawPixel(SSD1306_X + i, SSD1306_Y + j, !color);
            }
        }
    }
    
    SSD1306_X += 6;
    return ch;
}

// Put string
void SSD1306_Puts(char *str, uint8_t color) {
    while (*str) {
        if (SSD1306_Putc(*str, color) != *str) {
            return;
        }
        str++;
    }
}

// Clear screen
void SSD1306_Clear(void) {
    SSD1306_Fill(SSD1306_BLACK);
    SSD1306_UpdateScreen();
}

// Printf at position
void SSD1306_Printf(uint8_t x, uint8_t y, uint8_t color, const char *format, ...) {
    char buffer[32];
    va_list args;
    va_start(args, format);
    vsnprintf(buffer, sizeof(buffer), format, args);
    va_end(args);
    
    SSD1306_GotoXY(x, y);
    SSD1306_Puts(buffer, color);
}

// Draw line
void SSD1306_DrawLine(uint8_t x0, uint8_t y0, uint8_t x1, uint8_t y1, uint8_t color) {
    int16_t dx = abs(x1 - x0);
    int16_t dy = abs(y1 - y0);
    int16_t sx = (x0 < x1) ? 1 : -1;
    int16_t sy = (y0 < y1) ? 1 : -1;
    int16_t err = dx - dy;
    
    while (1) {
        SSD1306_DrawPixel(x0, y0, color);
        
        if (x0 == x1 && y0 == y1) break;
        
        int16_t e2 = 2 * err;
        if (e2 > -dy) {
            err -= dy;
            x0 += sx;
        }
        if (e2 < dx) {
            err += dx;
            y0 += sy;
        }
    }
}

// Draw rectangle
void SSD1306_DrawRectangle(uint8_t x, uint8_t y, uint8_t w, uint8_t h, uint8_t color) {
    SSD1306_DrawLine(x, y, x + w, y, color);
    SSD1306_DrawLine(x + w, y, x + w, y + h, color);
    SSD1306_DrawLine(x + w, y + h, x, y + h, color);
    SSD1306_DrawLine(x, y + h, x, y, color);
}

// Draw filled rectangle
void SSD1306_DrawFilledRectangle(uint8_t x, uint8_t y, uint8_t w, uint8_t h, uint8_t color) {
    for (uint8_t i = 0; i <= h; i++) {
        SSD1306_DrawLine(x, y + i, x + w, y + i, color);
    }
}
